## src/ESP32-S3/components/anthracide_i2c/Kconfig.projbuild
```kconfig
menu "Anthracide I2C Configuration"
    config I2C_NUM
        int "Number of i2c peripheral interface"
        default 0
        help
            The number of i2c peripheral interface of the Chip
                
    config I2C_SCL
        int "SCL GPIO Num"
        default 5
        help
            GPIO number for Anthracide I2C Master clock line.
        
    config I2C_SDA
        int "SDA GPIO Num"
        default 4
        help
            GPIO number for Anthracide I2C Master data line.
        
    config I2C_FREQ_HZ
        int "I2C Frequency"
        default 400000
        help
            The I2C Frequenz

endmenu    
```

## src/ESP32-S3/components/anthracide_led/Kconfig.projbuild
```kconfig
menu "Anthracide LED"

    config LED_RMT_CHANNEL
        int "RMT Channel"
        range 0 7
        default 0
        help
            Set the RMT peripheral channel.
            ESP32 RMT channel from 0 to 7
            ESP32-S2 RMT channel from 0 to 3
            ESP32-S3 RMT channel from 0 to 3
            ESP32-C3 RMT channel from 0 to 1

    config LED_GPIO
        int "LED GPIO number"
        range 0 48
        default 8 if IDF_TARGET_ESP32C3 || IDF_TARGET_ESP32H2
        default 18 if IDF_TARGET_ESP32S2
        default 48 if IDF_TARGET_ESP32S3
        default 5
        help
            GPIO number (IOxx) to blink on and off or the RMT signal for the addressable LED.            

    config BLINK_PERIOD
        int "Blink period in ms"
        range 50 3600000
        default 1000000
        help
            Define the blinking period in microseconds.

endmenu
```

## src/ESP32-S3/components/ir_nec_decoder/Kconfig.projbuild
```kconfig
menu "Anthracide IR Decoder"
    config RMT_RX_GPIO
        int "RMT RX GPIO"
        default 11
        help
            Set the GPIO number used for receiving the RMT signal.

    config RMT_RX_CHANNEL
        int "RMT RX Channel Number"
        default 4 if IDF_TARGET_ESP32S3
        default 2
        help
            Set the RMT RX channel number.



menu "Anthracide IR Remote codes"
    config IR_REMOTE_ADDRESS
        hex "Address of the remote transmitter"
        default 0xff00
        help
            IR transmitter identification.

    config IR_REMOTE_VOLUME_UP
        hex "Volum up key code"
        default 0xfa05
        help
            Identification of the volume up key.

    config IR_REMOTE_VOLUME_DOWN
        hex "Volum down key code"
        default 0xf807
        help
            Identification of the volume down key.
        
    config IR_REMOTE_MUTE
        hex "Mute key code"
        default 0xfc03
        help
            Identification of the mute key.
endmenu
endmenu
```

## src/ESP32-S3/components/nextion_display/Kconfig.projbuild
```kconfig
menu "Anthracide Nextion Display Configuration"

    config NEXTION_UART_PORT_NUM
        int "UART port number"
        range 0 2 if IDF_TARGET_ESP32   || IDF_TARGET_ESP32S3
        range 0 1 if IDF_TARGET_ESP32S2 || IDF_TARGET_ESP32C3
        default 2 if IDF_TARGET_ESP32   || IDF_TARGET_ESP32S3
        default 1 if IDF_TARGET_ESP32S2 || IDF_TARGET_ESP32C3
        help
            UART communication port number for Anthracide.
            See UART documentation for available port numbers.

    config NEXTION_UART_BAUD_RATE
        int "UART communication speed"
        range 1200 115200
        default 9600
        help
            UART communication speed for Modbus example.

    config NEXTION_UART_RXD
        int "UART RXD pin number"
        range 0 34 if IDF_TARGET_ESP32
        range 0 46 if IDF_TARGET_ESP32S2 || IDF_TARGET_ESP32S3
        range 0 19 if IDF_TARGET_ESP32C3
        default 18
        help
            GPIO number for UART RX pin. See UART documentation for more information
            about available pin numbers for UART.

    config NEXTION_UART_TXD
        int "UART TXD pin number"
        range 0 34 if IDF_TARGET_ESP32
        range 0 46 if IDF_TARGET_ESP32S2 || IDF_TARGET_ESP32S3
        range 0 19 if IDF_TARGET_ESP32C3
        default 17
        help
            GPIO number for UART TX pin. See UART documentation for more information
            about available pin numbers for UART.

endmenu
```

## src/ESP32-S3/components/sigma_dsp/Kconfig.projbuild
```kconfig
menu "Anthracide SigmaDSP Configuration"
    config SIGMA_DSP_RESET_PIN
        int "Number of SigmaDSP reset pin"
        default 6
        help
            The number of the SigmaDSP reset pin

    config SIGMA_DSP_I2C_ADDRESS
        int "I2C Address"
        default 104
        help
            I2C address of the SigmaDSP
endmenu    
```
